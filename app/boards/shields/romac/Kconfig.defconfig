## app/boards/shields/romac/Kconfig.defconfig
```kconfig
if SHIELD_ROMAC

config ZMK_KEYBOARD_NAME
	default "romac"

config ZMK_SPLIT
	default n

endif
```

## app/boards/shields/romac/Kconfig.shield
```kconfig
# Copyright (c) 2020 Paul Johansen, Richard Jones
# SPDX-License-Identifier: MIT

config SHIELD_ROMAC
	def_bool $(shields_list_contains,romac)
```
